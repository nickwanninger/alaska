## Kconfig
```kconfig
menu "Debug"
	config SANITY_CHECK
		bool "Perform expensive sanity checks in the runtime (bounds checks, etc)"
		default n

	config DUMP_TRANSLATIONS
		bool "Dump translations after they are created"
		default n

	config DUMP_TRANSLATIONS_FOCUS
		string "Comma separated list of functions to focus on when dumping translations"
		depends on DUMP_TRANSLATIONS
		default ""

	config DUMP_FLOW_GRAPH
		bool "Dump flow graphs after they are constructed"
		default n

	config VERIFY_PASS
		bool "Verify state of LLVM module while transformations are applied. Useful when debugging passes."
		default n
endmenu


menu "Experimental"
	config COMPILER_TIMING
		bool "Enable compiler timing for joining remote barriers"
		default n

	config SWAP_SUPPORT
		bool "Enable swap-in checking in the translation operation"
		default n

	config TRACK_TRANSLATION_HITRATE
		bool "Track hit/miss rate for translations. Warning: VERY SLOW"
		default n


	config ARGUMENT_TRACE
		bool "Dynamically trace if arguments to functions are handles or not and dump it to a trace file"
		default n

endmenu



menu "Logging"

config LOG_LEVEL_TRACE
	bool "Enable TRACE level logging (recommended to leave off for performance reasons)"
	default n

config LOG_LEVEL_DEBUG
	bool "Enable DEBUG level logging"
	default y

config LOG_LEVEL_INFO
	bool "Enable INFO level logging"
	default y

config LOG_LEVEL_WARN
	bool "Enable WARN level logging"
	default y

config LOG_LEVEL_ERROR
	bool "Enable ERROR level logging"
	default y

config LOG_LEVEL_FATAL
	bool "Enable FATAL level logging"
	default y
endmenu


config SIZE_BITS
  int "How many bits to use for handle sizes. Smaller = more handles. Larger = less handles"
  default 32

config SQUEEZE_BITS
  int # "how much to squeeze by (recommended to set this to 3"
  default 3

config ENABLE_TESTING
  bool "Enable runtime testing"
  default y
```
